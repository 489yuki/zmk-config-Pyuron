## Kconfig
```kconfig
config ZMK_INPUT_PROCESSOR_TRACKBALL_TO_KEY
    bool "Trackball to key input processor"
    default y
    depends on ZMK_POINTING
```

## dts/bindings/zmk,input-processor-trackball-to-key.yaml
```yaml
description: |
  Converts trackball X-axis relative movement into key tap events.
  Right movement fires one key (default: Tab), left movement fires another (default: Left Shift).
  Movement is accumulated and a key tap is emitted each time the threshold is exceeded.

compatible: "zmk,input-processor-trackball-to-key"

include: base.yaml

properties:
  "#binding-cells":
    const: 0
  threshold:
    type: int
    default: 10
    description: Accumulated movement needed to fire one key tap
  deadzone:
    type: int
    default: 1
    description: Minimum abs(dx) to consider (noise filter)
  max-per-event:
    type: int
    default: 3
    description: Maximum key taps per single input event
  right-keycode:
    type: int
    default: 0x2B  # HID_USAGE_KEY_KEYBOARD_TAB
    description: HID keycode emitted on right movement
  left-keycode:
    type: int
    default: 0xE1  # HID_USAGE_KEY_KEYBOARD_LEFTSHIFT
    description: HID keycode emitted on left movement
```
